## Documentation/devicetree/bindings/net/nxp,tja11xx.yaml
```yaml
# SPDX-License-Identifier: GPL-2.0+
%YAML 1.2
---
$id: http://devicetree.org/schemas/net/nxp,tja11xx.yaml#
$schema: http://devicetree.org/meta-schemas/core.yaml#

title: NXP TJA11xx PHY

maintainers:
  - Andrew Lunn <andrew@lunn.ch>
  - Florian Fainelli <f.fainelli@gmail.com>
  - Heiner Kallweit <hkallweit1@gmail.com>

description:
  Bindings for NXP TJA11xx automotive PHYs

allOf:
  - $ref: ethernet-phy.yaml#

  - if:
      properties:
        compatible:
          contains:
            enum:
              - ethernet-phy-id001b.b010
              - ethernet-phy-id001b.b013
              - ethernet-phy-id001b.b030
              - ethernet-phy-id001b.b031

    then:
      properties:
        nxp,rmii-refclk-out:
          type: boolean
          description: Enable 50MHz RMII reference clock output on REF_CLK pin.

patternProperties:
  "^ethernet-phy@[0-9a-f]+$":
    type: object
    description: |
      Some packages have multiple PHYs. Secondary PHY should be defines as
      subnode of the first (parent) PHY.

    properties:
      reg:
        minimum: 0
        maximum: 31
        description:
          The ID number for the child PHY. Should be +1 of parent PHY.

    required:
      - reg

unevaluatedProperties: false

examples:
  - |
    mdio {
        #address-cells = <1>;
        #size-cells = <0>;

        tja1101_phy0: ethernet-phy@4 {
            reg = <0x4>;
        };
    };
  - |
    mdio {
        #address-cells = <1>;
        #size-cells = <0>;

        tja1102_phy0: ethernet-phy@4 {
            reg = <0x4>;
            #address-cells = <1>;
            #size-cells = <0>;

            tja1102_phy1: ethernet-phy@5 {
                reg = <0x5>;
            };
        };
    };
```

## Kconfig
```kconfig
# SPDX-License-Identifier: GPL-2.0
#
# For a description of the syntax of this configuration file,
# see Documentation/kbuild/kconfig-language.txt.
#
mainmenu "Linux/$(ARCH) $(KERNELVERSION) Kernel Configuration"

comment "Compiler: $(CC_VERSION_TEXT)"

source "scripts/Kconfig.include"

source "arch/$(SRCARCH)/Kconfig"

config RH_KABI_SIZE_ALIGN_CHECKS
	bool "Enables more stringent kabi checks in the macros"
	default y
	help
	  This option enables more stringent kabi checks. Those must be disable
	  in case of a debug-build because they allow to change struct sizes.
```

## Kconfig.redhat
```kconfig
# SPDX-License-Identifier: GPL-2.0-only
#
# Red Hat specific options
#

menu "Red Hat options"

config RHEL_DIFFERENCES
	bool "Enable RHEL-only code"
	help
	  This option controls whether rhel-only changes are enabled during
	  the build. Unless you want to enable rhel-only changes, say N here.

config RH_KABI_SIZE_ALIGN_CHECKS
	bool "Enables more stringent kabi checks in the macros"
	depends on RHEL_DIFFERENCES
	default y
	help
	  This option enables more stringent kabi checks. Those must
	  be disabled in case of a debug build, because debug builds
	  allow to change struct sizes.

endmenu
```

## drivers/counter/Kconfig
```kconfig
# SPDX-License-Identifier: GPL-2.0-only
#
# Counter devices
#

menuconfig COUNTER
	tristate "Counter support"
	help
	  This enables counter device support through the Generic Counter
	  interface. You only need to enable this, if you also want to enable
	  one or more of the counter device drivers below.

if COUNTER

config INTEL_QEP
	tristate "Intel Quadrature Encoder Peripheral driver"
	depends on PCI
	help
	  Select this option to enable the Intel Quadrature Encoder Peripheral
	  driver.

	  To compile this driver as a module, choose M here: the module
	  will be called intel-qep.

endif # COUNTER
```

## drivers/crypto/chelsio/Kconfig
```kconfig
config CRYPTO_DEV_CHELSIO
	tristate "Chelsio Crypto Co-processor Driver"
	depends on CHELSIO_T4
	select CRYPTO_SHA1
	select CRYPTO_SHA256
	select CRYPTO_SHA512
	select CRYPTO_AUTHENC
	select CRYPTO_GF128MUL
	help
	  The Chelsio Crypto Co-processor driver for T6 adapters.

	  For general information about Chelsio and our products, visit
	  our website at <http://www.chelsio.com>.

	  For customer support, please visit our customer support page at
	  <http://www.chelsio.com/support.html>.

	  Please send feedback to <linux-bugs@chelsio.com>.

	  To compile this driver as a module, choose M here: the module
	  will be called chcr.

config CRYPTO_DEV_CHELSIO_TLS
        tristate "Chelsio Crypto Inline TLS Driver"
        depends on CHELSIO_T4
        depends on TLS_TOE
        select CRYPTO_DEV_CHELSIO
	help
          Support Chelsio Inline TLS with Chelsio crypto accelerator.

	  To compile this driver as a module, choose M here: the module
	  will be called chtls.
```

## drivers/infiniband/hw/mlx5/Kconfig
```kconfig
config MLX5_INFINIBAND
	tristate "Mellanox Connect-IB HCA support"
	depends on NETDEVICES && INET && PCI
	select MLX5_CORE
	---help---
	  This driver provides low-level InfiniBand support for
	  Mellanox Connect-IB PCI Express host channel adapters (HCAs).
	  This is required to use InfiniBand protocols such as
	  IP-over-IB or SRP with these devices.
```

## drivers/infiniband/hw/usnic/Kconfig
```kconfig
config INFINIBAND_USNIC
	tristate "Verbs support for Cisco VIC"
	depends on NETDEVICES && NET_ETHERNET && INET && PCI
	select ENIC
	select PCI_IOV
	select INFINIBAND_USER_ACCESS
	---help---
	  This is a low-level driver for Cisco's Virtual Interface
	  Cards (VICs), including the VIC 1240 and 1280 cards.
```

## drivers/net/pcs/Kconfig
```kconfig
# SPDX-License-Identifier: GPL-2.0-only
#
# PCS Layer Configuration
#

menu "PCS device drivers"

config PCS_XPCS
	tristate
	select PHYLINK
	help
	  This module provides helper functions for Synopsys DesignWare XPCS
	  controllers.

endmenu
```

## drivers/net/wireless/virtual/Kconfig
```kconfig
config MAC80211_HWSIM
	tristate "Simulated radio testing tool for mac80211"
	depends on MAC80211
	help
	  This driver is a developer testing tool that can be used to test
	  IEEE 802.11 networking stack (mac80211) functionality. This is not
	  needed for normal wireless LAN usage and is only for testing. See
	  Documentation/networking/mac80211_hwsim for more information on how
	  to use this tool.

	  To compile this driver as a module, choose M here: the module will be
	  called mac80211_hwsim.  If unsure, say N.
```

## drivers/platform/x86/intel/Kconfig
```kconfig
# SPDX-License-Identifier: GPL-2.0-only
#
# Intel x86 Platform Specific Drivers
#

menuconfig X86_PLATFORM_DRIVERS_INTEL
	bool "Intel x86 Platform Specific Device Drivers"
	default y
	help
	  Say Y here to get to see options for device drivers for
	  various Intel x86 platforms, including vendor-specific
	  drivers. This option alone does not add any kernel code.

	  If you say N, all options in this submenu will be skipped
	  and disabled.

if X86_PLATFORM_DRIVERS_INTEL

source "drivers/platform/x86/intel/ifs/Kconfig"
source "drivers/platform/x86/intel/int1092/Kconfig"
source "drivers/platform/x86/intel/int33fe/Kconfig"
source "drivers/platform/x86/intel/int3472/Kconfig"
source "drivers/platform/x86/intel/pmc/Kconfig"
source "drivers/platform/x86/intel/pmt/Kconfig"
source "drivers/platform/x86/intel/speed_select_if/Kconfig"
source "drivers/platform/x86/intel/wmi/Kconfig"
source "drivers/platform/x86/intel/uncore-frequency/Kconfig"

config INTEL_HID_EVENT
	tristate "Intel HID Event"
	depends on ACPI
	depends on INPUT
	depends on I2C
	select INPUT_SPARSEKMAP
	help
	  This driver provides support for the Intel HID Event hotkey interface.
	  Some laptops require this driver for hotkey support.

	  To compile this driver as a module, choose M here: the module will
	  be called intel_hid.

config INTEL_SDSI
	tristate "Intel On Demand (Software Defined Silicon) Driver"
	depends on INTEL_VSEC
	depends on X86_64
	help
	  This driver enables access to the Intel On Demand (formerly Software
	  Defined Silicon) interface used to provision silicon features with an
	  authentication certificate and capability license.

	  To compile this driver as a module, choose M here: the module will
	  be called intel_sdsi.

config INTEL_TPMI
	tristate "Intel Topology Aware Register and PM Capsule Interface (TPMI)"
	depends on INTEL_VSEC
	depends on X86_64
	help
	  The Intel Topology Aware Register and PM Capsule Interface (TPMI),
	  provides enumerable MMIO interface for power management features.
	  This driver creates devices, so that other PM feature driver can
	  be loaded for PM specific feature operation.

	  To compile this driver as a module, choose M here: the module will
	  be called intel_vsec_tpmi.


config INTEL_VSEC
	tristate "Intel Vendor Specific Extended Capabilities Driver"
	depends on PCI
	select AUXILIARY_BUS
	help
	  Adds support for feature drivers exposed using Intel PCIe VSEC and
	  DVSEC.

	  To compile this driver as a module, choose M here: the module will
	  be called intel_vsec.

config INTEL_ISHTP_ECLITE
       tristate "Intel ISHTP eclite controller Driver"
       depends on INTEL_ISH_HID
       depends on ACPI
       help
         This driver is for accessing the PSE (Programmable Service Engine) -
         an Embedded Controller like IP - using ISHTP (Integrated Sensor Hub
         Transport Protocol) to get battery, thermal and UCSI (USB Type-C
         Connector System Software Interface) related data from the platform.
         Users who don't want to use discrete Embedded Controller on Intel's
         Elkhartlake platform can leverage this integrated solution of
         ECLite which is part of PSE subsystem.

         To compile this driver as a module, choose M here: the module
         will be called intel_ishtp_eclite.

endif # X86_PLATFORM_DRIVERS_INTEL
```

## drivers/platform/x86/intel/pmc/Kconfig
```kconfig
# SPDX-License-Identifier: GPL-2.0
#
# Intel x86 Platform-Specific Drivers
#

config INTEL_PMC_CORE
	tristate "Intel PMC Core driver"
	depends on PCI
	depends on ACPI
	---help---
	  The Intel Platform Controller Hub for Intel Core SoCs provides access
	  to Power Management Controller registers via a PCI interface. This
	  driver can utilize debugging capabilities and supported features as
	  exposed by the Power Management Controller.

	  Supported features:
		- SLP_S0_RESIDENCY counter
		- PCH IP Power Gating status
		- LTR Ignore
		- MPHY/PLL gating status (Sunrisepoint PCH only)
```

## drivers/scsi/bnx2fc/Kconfig
```kconfig
config SCSI_BNX2X_FCOE
	tristate "QLogic FCoE offload support"
	depends on PCI
	select NETDEVICES
	select NETDEV_1000
	select LIBFC
	select LIBFCOE
	select CNIC
	---help---
	This driver supports FCoE offload for the QLogic devices.
```

## drivers/soc/mediatek/Kconfig
```kconfig
# SPDX-License-Identifier: GPL-2.0-only
#
# MediaTek SoC drivers
#
menu "MediaTek SoC drivers"
	depends on ARCH_MEDIATEK || COMPILE_TEST

config MTK_CMDQ
	tristate "MediaTek CMDQ Support"
	depends on ARCH_MEDIATEK || COMPILE_TEST
	select MAILBOX
	select MTK_CMDQ_MBOX
	select MTK_INFRACFG
	help
	  Say yes here to add support for the MediaTek Command Queue (CMDQ)
	  driver. The CMDQ is used to help read/write registers with critical
	  time limitation, such as updating display configuration during the
	  vblank.

config MTK_DEVAPC
	tristate "Mediatek Device APC Support"
	help
	  Say yes here to enable support for Mediatek Device APC driver.
	  This driver is mainly used to handle the violation which catches
	  unexpected transaction.
	  The violation information is logged for further analysis or
	  countermeasures.

config MTK_INFRACFG
	bool "MediaTek INFRACFG Support"
	select REGMAP
	help
	  Say yes here to add support for the MediaTek INFRACFG controller. The
	  INFRACFG controller contains various infrastructure registers not
	  directly associated to any device.

config MTK_PMIC_WRAP
	tristate "MediaTek PMIC Wrapper Support"
	depends on RESET_CONTROLLER
	depends on OF
	select REGMAP
	help
	  Say yes here to add support for MediaTek PMIC Wrapper found
	  on different MediaTek SoCs. The PMIC wrapper is a proprietary
	  hardware to connect the PMIC.

config MTK_MMSYS
	bool "MediaTek MMSYS Support"
	default ARCH_MEDIATEK
	depends on HAS_IOMEM
	help
	  Say yes here to add support for the MediaTek Multimedia
	  Subsystem (MMSYS).

endmenu
```

## drivers/soc/rockchip/Kconfig
```kconfig
# SPDX-License-Identifier: GPL-2.0-only
if ARCH_ROCKCHIP || COMPILE_TEST

#
# Rockchip Soc drivers
#

config ROCKCHIP_GRF
	bool
	default y
	help
	  The General Register Files are a central component providing
	  special additional settings registers for a lot of soc-components.
	  In a lot of cases there also need to be default settings initialized
	  to make some of them conform to expectations of the kernel.

config ROCKCHIP_IODOMAIN
	tristate "Rockchip IO domain support"
	depends on OF
	help
	  Say y here to enable support io domains on Rockchip SoCs. It is
	  necessary for the io domain setting of the SoC to match the
	  voltage supplied by the regulators.

endif
```

## drivers/thermal/Kconfig
```kconfig
#
# Generic thermal sysfs drivers configuration
#

menuconfig THERMAL
	tristate "Generic Thermal sysfs driver"
	help
	  Generic Thermal Sysfs driver offers a generic mechanism for
	  thermal management. Usually it's made up of one or more thermal
	  zone and cooling device.
	  Each thermal zone contains its own temperature, trip points,
	  cooling devices.
	  All platforms with ACPI thermal support can use this driver.
	  If you want this support, you should say Y or M here.

config THERMAL_HWMON
	bool "Hardware monitoring support"
	depends on THERMAL
	depends on HWMON=y || HWMON=THERMAL
	help
	  The generic thermal sysfs driver's hardware monitoring support
	  requires a 2.10.7/3.0.2 or later lm-sensors userspace.

	  Say Y if your user-space is new enough.
config INTEL_POWERCLAMP
	tristate "Intel PowerClamp idle injection driver"
	depends on THERMAL
	depends on X86
	depends on CPU_SUP_INTEL
	help
	  Enable this to enable Intel PowerClamp idle injection driver. This
	  enforce idle time which results in more package C-state residency. The
	  user interface is exposed via generic thermal framework.
```
